## boards/shields/dongle-test/Kconfig.defconfig
```kconfig
if SHIELD_ZARUBALL_F

# Name must be less than 16 characters long!
config ZMK_KEYBOARD_NAME
    default "ZaruBall"

config ZMK_SPLIT_ROLE_CENTRAL
    default y

config ZMK_SPLIT_BLE_CENTRAL_PERIPHERALS
    default 2

endif

if SHIELD_ZARUBALL_L || SHIELD_ZARUBALL_R || SHIELD_ZARUBALL_F

config ZMK_SPLIT
    default y

endif

if SHIELD_ZARUBALL_F || SHIELD_ZARUBALL_R

config ZMK_POINTING
    default y

endif

if SHIELD_ZARUBALL_R

# Assuming pointing device uses SPI
config SPI
    default y

endif
```

## boards/shields/dongle-test/Kconfig.shield
```kconfig
config SHIELD_ZARUFOOT_F
    def_bool $(shields_list_contains,zarufoot_f)

config SHIELD_ZARUFOOT_R
    def_bool $(shields_list_contains,zarufoot_r)

config SHIELD_ZARUFOOT_L
    def_bool $(shields_list_contains,zarufoot_l)
```

## config/west.yml
```yaml
manifest:
  remotes:
    - name: zmkfirmware
      url-base: https://github.com/zmkfirmware
    - name: badjeff # <-- 'inorichi' を 'badjeff' に変更
      url-base: https://github.com/badjeff
  projects:
    - name: zmk
      remote: zmkfirmware
      revision: main
      import: app/west.yml
    - name: zmk-pmw3610-driver # <-- 問題のモジュール
      remote: badjeff # <-- 参照先を 'badjeff' に変更
      revision: main
  self:
    path: config
```
